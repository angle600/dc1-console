## firmware/c/sdkconfig.defaults
```kconfig
# DC1 C 版 —— 默认构建配置（ESP8266_RTOS_SDK v3.2）
# 目标硬件：1 MB flash / ESP8266EX

# ---- flash ----
CONFIG_ESPTOOLPY_FLASHSIZE_1MB=y
CONFIG_ESPTOOLPY_FLASHSIZE="1MB"
CONFIG_PARTITION_TABLE_SINGLE_APP=y

# ---- CPU / RTOS ----
CONFIG_ESP8266_DEFAULT_CPU_FREQ_160=y
CONFIG_FREERTOS_HZ=100

# ---- 串口 ----
CONFIG_ESPTOOLPY_BAUD_115200B=y
CONFIG_ESPTOOLPY_BAUD=115200
CONFIG_CONSOLE_UART_BAUDRATE=115200

# ---- 日志 ----
CONFIG_LOG_DEFAULT_LEVEL_INFO=y
CONFIG_LOG_COLORS=n

# ---- 关掉用不到的大件，给 app 分区省空间 ----
CONFIG_AWS_IOT_SDK=n
CONFIG_MBEDTLS_CERTIFICATE_BUNDLE=n
CONFIG_ESP_TLS_USING_MBEDTLS=n
CONFIG_ESP_TLS_USING_WOLFSSL=n
```
